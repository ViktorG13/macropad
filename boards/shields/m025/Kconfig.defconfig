## boards/shields/m025/Kconfig.defconfig
```kconfig
if SHIELD_M025

config ZMK_KEYBOARD_NAME
    default "custom"

endif # SHIELD_M025
```

## boards/shields/macropad/Kconfig.defconfig
```kconfig
if SHIELD_M025

config ZMK_KEYBOARD_NAME
    default "macropad"

endif # SHIELD_M025
```
